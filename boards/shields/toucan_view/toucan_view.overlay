/*
 * Toucan left-half display (nice!view GEM, Sharp LS0xx memory LCD, 144x168).
 * Wiring matches the toucan_pet overlay that shipped with this board.
 * SPDX-License-Identifier: MIT
 */

&nice_view_spi {
    status = "okay";
    nice_view: ls0xx@0 {
        compatible = "sharp,ls0xx";
        spi-max-frequency = <1000000>;
        reg = <0>;
        width = <144>;
        height = <168>;
    };
};

/ {
    chosen {
        zephyr,display = &nice_view;
    };
};
