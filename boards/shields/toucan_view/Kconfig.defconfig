## boards/shields/toucan_view/Kconfig.defconfig
```kconfig
# SPDX-License-Identifier: MIT

if SHIELD_TOUCAN_VIEW

config LS0XX_VCOM_THREAD_PRIO
    default 11

config LV_Z_VDB_SIZE
    default 100

config LV_Z_BITS_PER_PIXEL
    default 1

choice LV_COLOR_DEPTH
    default LV_COLOR_DEPTH_1
endchoice

choice ZMK_DISPLAY_WORK_QUEUE
    default ZMK_DISPLAY_WORK_QUEUE_DEDICATED
endchoice

choice ZMK_DISPLAY_STATUS_SCREEN
    default ZMK_DISPLAY_STATUS_SCREEN_BUILT_IN
endchoice

config LV_Z_MEM_POOL_SIZE
    default 5120

config ZMK_DISPLAY_STATUS_SCREEN_BUILT_IN
    select LV_FONT_MONTSERRAT_26

endif # SHIELD_TOUCAN_VIEW
```

## boards/shields/toucan_view/Kconfig.shield
```kconfig
# SPDX-License-Identifier: MIT

config SHIELD_TOUCAN_VIEW
    def_bool $(shields_list_contains,toucan_view)
```

## dts/bindings/zmk,input-processor-tap-dedupe.yaml
```yaml
# SPDX-License-Identifier: MIT
description: >
  Edge-trigger BTN_TOUCH events so only real press/release transitions are
  forwarded (dedupes the redundant per-sample button events the mainline Cirque
  driver emits over the ZMK split link).
compatible: "zmk,input-processor-tap-dedupe"

include: ip_zero_param.yaml
```
